## boards/arm/arduino_nano_33_ble/arduino_nano_33_ble_defconfig
```kconfig
# SPDX-License-Identifier: Apache-2.0

CONFIG_SOC_SERIES_NRF52X=y
CONFIG_SOC_NRF52840_QIAA=y
CONFIG_BOARD_ARDUINO_NANO_33_BLE=y

# Enable MPU
CONFIG_ARM_MPU=y
CONFIG_HW_STACK_PROTECTION=y

# enable peripherals
CONFIG_GPIO=y
CONFIG_SERIAL=y

# enable sam-ba bootloader on legacy mode
CONFIG_BOOTLOADER_BOSSA=y
CONFIG_BOOTLOADER_BOSSA_LEGACY=y

# additional board options
CONFIG_GPIO_AS_PINRESET=y

CONFIG_USB_DEVICE_STACK=y
CONFIG_USB_DEVICE_PRODUCT="Zephyr USB console sample"

CONFIG_UART_LINE_CTRL=y
CONFIG_BOARD_ARDUINO_NANO_33_BLE_EN_USB_CONSOLE=y
```

## lib/gui/lvgl/Kconfig
```kconfig
# Copyright (c) 2018-2019 Jan Van Winkel <jan.van_winkel@dxplore.eu>
# Copyright (c) 2020 Teslabs Engineering S.L.
# SPDX-License-Identifier: Apache-2.0

menuconfig LVGL
	bool "LittlevGL GUI library"
	help
	  This option enables the LittlevGL GUI library.

if LVGL

module = LVGL
module-str = lvgl
source "subsys/logging/Kconfig.template.log_config"

config LV_CONF_SKIP
	default n

config APP_LINK_WITH_LVGL
	bool "Link 'app' with LVGL"
	default y
	help
	  Add LVGL header files to the 'app' include path. It may be
	  disabled if the include paths for LVGL are causing aliasing
	  issues for 'app'.

config LVGL_USE_FILESYSTEM
	bool "Enable file system"
	depends on FILE_SYSTEM
	default y if FILE_SYSTEM
	help
	  Enable LittlevGL file system

rsource "Kconfig.graphical"
rsource "Kconfig.memory"
rsource "Kconfig.input"

source "../modules/lib/gui/lvgl/Kconfig"

endif # LVGL
```
