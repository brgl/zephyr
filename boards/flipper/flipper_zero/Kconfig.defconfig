## boards/flipper/flipper_zero/Kconfig.defconfig
```kconfig
# SPDX-FileCopyrightText: Copyright The Zephyr Project Contributors
# SPDX-License-Identifier: Apache-2.0

if BOARD_FLIPPER_ZERO

source "boards/common/usb/Kconfig.cdc_acm_serial.defconfig"

if LVGL

config LV_Z_VDB_SIZE
	default 64

configdefault LV_Z_DPI_DEF
	default 102

choice LV_Z_COLOR_FORMAT
	default LV_Z_COLOR_FORMAT_I1
endchoice

endif # LVGL

endif # BOARD_FLIPPER_ZERO
```

## boards/flipper/flipper_zero/flipper_zero_defconfig
```kconfig
# SPDX-FileCopyrightText: Copyright The Zephyr Project Contributors
# SPDX-License-Identifier: Apache-2.0

# Serial console on the GPIO header
CONFIG_SERIAL=y
CONFIG_CONSOLE=y
CONFIG_UART_CONSOLE=y

# Enable GPIO
CONFIG_GPIO=y

# Enable MPU
CONFIG_ARM_MPU=y

# Enable HW stack protection
CONFIG_HW_STACK_PROTECTION=y
```
